## arch/arm/mach-exynos/Kconfig.local
```kconfig
choice
	prompt "Target Locale"
	default TARGET_LOCALE_EUR

config TARGET_LOCALE_EUR
	bool "Europe Open"

config TARGET_LOCALE_LTN
	bool "Latin"

config TARGET_LOCALE_KOR
	bool "Kor"

config TARGET_LOCALE_NAATT_TEMP
	bool "NAGSM"

config TARGET_LOCALE_P2EUR_TEMP
	bool "P2EUR"

config TARGET_LOCALE_P2TMO_TEMP
	bool "P2TMO"

config TARGET_LOCALE_EUR_U1_NFC
	bool "Europe Open NFC"

config TARGET_LOCALE_NTT
	bool "JPN"

config TARGET_LOCALE_CHN
	bool "Chinese"

config TARGET_LOCALE_USA
	bool "USA"

endchoice

choice
	prompt "C1 USA Target Carrier"
	depends on MACH_C1 && (TARGET_LOCALE_EUR || TARGET_LOCALE_USA)
	default MACH_C1_USA_ATT

config MACH_C1_USA_ATT
	bool "ATT"

config MACH_C1_USA_VZW
	bool "VZW"
endchoice

choice
	prompt "C2 USA Target Carrier"
	depends on MACH_C2 && TARGET_LOCALE_USA
	default MACH_C2_USA_VZW

config MACH_C2_USA_VZW
	bool "C2 Verizon"

config MACH_C2_USA_SPR
	bool "C2 Sprint"
endchoice

choice
	prompt "T0 Target"
	depends on MACH_T0 && (TARGET_LOCALE_EUR || TARGET_LOCALE_USA)
	default MACH_T0_EUR_OPEN

config MACH_T0_USA_ATT
	bool "ATT"

config MACH_T0_USA_TMO
	bool "TMO"

config MACH_T0_USA_VZW
	bool "VZW"

config MACH_T0_USA_SPR
	bool "SPR"

config MACH_T0_USA_USCC
	bool "USCC"

config MACH_T0_EUR_LTE
	bool "EUR LTE"

config MACH_T0_EUR_OPEN
	bool "EUR OPEN"

endchoice

choice
	prompt "U1 KOR Target Carrier"
	depends on MACH_U1 && TARGET_LOCALE_KOR
	default MACH_U1_KOR_SKT

config MACH_U1_KOR_SKT
	bool "SKT"

config MACH_U1_KOR_KT
	bool "KT"

config MACH_U1_KOR_LGT
	bool "LG U+"
endchoice

choice
	prompt "C1 KOR Target Carrier"
	depends on (MACH_C1 || MACH_C1VZW) && TARGET_LOCALE_KOR
	default MACH_C1_KOR_SKT

config MACH_C1_KOR_SKT
	bool "SKT"

config MACH_C1_KOR_KT
	bool "KT"

config MACH_C1_KOR_LGT
	bool "LG U+"
endchoice

choice
	prompt "M0 KOR Target Carrier"
	depends on MACH_M0 && TARGET_LOCALE_KOR
	default MACH_M0_KOR_SKT

config MACH_M0_KOR_SKT
	bool "SKT"

config MACH_M0_KOR_KT
	bool "KT"

config MACH_M0_KOR_LGT
	bool "LG U+"
endchoice

choice
	prompt "P4 KOR Target Carrier"
	depends on MACH_P4NOTE && TARGET_LOCALE_KOR
	default MACH_P4NOTE_KOR_ANY

config MACH_P4NOTE_KOR_ANY
	bool "P4NOTE KOR OPEN Board"

config MACH_P4NOTE_KOR_SKT
	bool "P4NOTE KOR SKT Board"

config MACH_P4NOTE_KOR_KT
	bool "P4NOTE KOR KT Board"
endchoice

choice
	prompt "M0 Chinese Target Carrier"
	depends on (MACH_M0 || MACH_GRANDE) && TARGET_LOCALE_CHN

config MACH_M0_CMCC
	bool "M0 CHN CMCC board"

config MACH_M0_CHNOPEN
	bool "M0 CHN OPEN board"

config MACH_M0_HKTW
	bool "M0 CHN HKTW board"

config MACH_M0_CTC
	bool "M0 CHN CTC board"
endchoice

choice
	prompt "Q1 Chinese Target Carrier"
	depends on MACH_U1 && TARGET_LOCALE_CHN

config MACH_Q1_CMCC_BD
	bool "Q1 CHN CMCC board"
endchoice

menu "M0 CTC based models"
	depends on MACH_M0_CTC && TARGET_LOCALE_CHN

config MACH_M0_GRANDECTC
	bool "M0 CHN GRANDE CTC board"
endmenu
```

## drivers/battery/Kconfig
```kconfig
menuconfig POWER_SUPPLY
	tristate "Power supply class support"
	help
	  Say Y here to enable power supply class support. This allows
	  power supply (batteries, AC, USB) monitoring by userspace
	  via sysfs and uevent (if available) and/or APM kernel interface
	  (if selected below).

if POWER_SUPPLY

config BATTERY_SEC
	tristate "SAMSUNG battery driver"
	depends on ARCH_S5PV310
	help
	  Say Y to enable samsung battery driver for devices with S5PV310 chip.

config MAX8997_CHARGER
	tristate "MAX8997 battery charger support"
	depends on MFD_MAX8997
	help
	  Say Y here to enable support for the battery charger in the Maxim
	  MAX8997 PMIC.

config BATTERY_MAX17043_FUELGAUGE
	tristate "Maxim MAX17043 Fuel Gauge"
	depends on I2C
	help
	  MAX17043 is fuel-gauge systems for lithium-ion (Li+) batteries
	  in handheld and portable equipment. The MAX17043 is configured
	  to operate with a single lithium cell

config BATTERY_MAX17042_FUELGAUGE
	tristate "Maxim MAX17042 Fuel Gauge"
	depends on I2C
	help
	  MAX17042 is fuel-gauge systems for lithium-ion (Li+) batteries
	  in handheld and portable equipment. The MAX17042 is configured
	  to operate with a single lithium cell

config BATTERY_MAX17047_FUELGAUGE
	tristate "Maxim MAX17047 Fuel Gauge"
	depends on I2C
	help
	  MAX17047 is fuel-gauge systems for lithium-ion (Li+) batteries
	  in handheld and portable equipment. The MAX17047 is configured
	  to operate with a single lithium cell

config BATTERY_SMB136_CHARGER
	tristate "SMB136 battery charger support"
	depends on I2C
	help
	  Say Y here to enable support for the SMB136 charger

config BATTERY_MAX77693_CHARGER
	tristate "MAX77693 battery charger support"
	depends on MFD_MAX77693 && I2C
	help
	  Say Y here to enable support for the MAX77693 charger

config BATTERY_WPC_CHARGER
	tristate "wireless charger support"
	depends on BATTERY_MAX77693_CHARGER
	help
	  Say Y here to enable support for the MAX77693 charger

endif # POWER_SUPPLY
```

## drivers/gpu/drm/exynos/Kconfig
```kconfig
config DRM_EXYNOS
	tristate "DRM Support for Samsung SoC EXYNOS Series"
	depends on DRM && PLAT_SAMSUNG
	default	n
	select DRM_KMS_HELPER
	select FB_CFB_FILLRECT
	select FB_CFB_COPYAREA
	select FB_CFB_IMAGEBLIT
	select VT_HW_CONSOLE_BINDING if FRAMEBUFFER_CONSOLE
	help
	  Choose this option if you have a Samsung SoC EXYNOS chipset.
	  If M is selected the module will be called exynosdrm.

config DRM_EXYNOS_DMABUF
	bool "Samsung DRM DMABUF"
	depends on DMA_SHARED_BUFFER
	default n
	help
	  This enables EXYNOS DRM DMABUF feature that it can be used for
	  file descriptor based memory sharing between DRM GEM and others.

config DRM_EXYNOS_MEMSIZE
	int "Memory size in kbytes for DRM"
	depends on DRM_EXYNOS
	default "32768"

config DRM_EXYNOS_FIMD
	tristate "Samsung DRM FIMD"
	depends on DRM_EXYNOS
	default n
	help
	  Choose this option if you want to use Samsung FIMD for DRM.
	  If M is selected, the module will be called exynos_drm_fimd

config DRM_EXYNOS_HDMI
	tristate "Samsung DRM HDMI"
	depends on DRM_EXYNOS
	help
	  Choose this option if you want to use Samsung HDMI for DRM.
	  If M is selected, the module will be called exynos_drm_hdmi
```

## drivers/j4fs/Kconfig
```kconfig
menuconfig J4FS
	tristate "Samsung J4FS"
	help
	   Samsung J4FS support.

if J4FS

choice
	prompt "Select J4FS Interface"
	default J4FS_USE_FSR

config J4FS_USE_XSR
	bool "XSR Interface"
config J4FS_USE_FSR
	bool "FSR Interface"
config J4FS_USE_MOVI
	bool "MOVI Interface"

endchoice

config J4FS_PARTITION_ID
	int "Select Mount Partition ID"
	depends on !J4FS_USE_MOVI
	default 21
	help
	   Select Mount Partition ID.

config J4FS_DEVNAME
	string "Select Mount Partition Path"
	depends on J4FS_USE_MOVI
	default "/dev/block/mmcblk0p4"
	help
	   Select Mount Partition Path.

config J4FS_PAGE_SHIFT
	int "J4FS Page Size (11 -> 2048 KB or 12 -> 4096 KB)"
	depends on J4FS
	default 12
	help
	  Select Page Size.
          Block Size is calculated by below formala.
	  Example : Block Size = (Page Size * 64) KB

config J4FS_BLOCK_COUNT
	int "J4FS Block Count"
	depends on J4FS_USE_MOVI
	default 20
	help
	  Select Block Count.
	  Blcok Size is decided by J4FS Page Size.
	  Example : Blcok Count = (Total Size / Block Size)

endif
```

## drivers/media/isdbt/Kconfig
```kconfig
config ISDBT
	bool "isdbt"

choice
	depends on ISDBT
	prompt "isdbt one-seg driver"
	default ISDBT_FC8150

	config ISDBT_FC8150
		bool "ISDBT_FC8150"

	config ISDBT_FC8100
		bool "ISDBT_FC8100"

	config ISDBT_ANT_DET
		depends on ISDBT
		bool "ISDBT antenna detector"
endchoice
```

## drivers/media/tdmb/Kconfig
```kconfig
#
# TDMB config states
#

#klaatu TDMB
config TDMB
	bool "T-DMB"
	help
	  This allows T-DMB support for Korea.
	  This module is designed for SPI or EBI2.
	  Select chipset and interface

choice
	depends on TDMB
	prompt "vendor"
	default TDMB_VENDOR_FCI
	config TDMB_VENDOR_INC
		bool "I&C"
	config TDMB_VENDOR_FCI
		bool "FCI"
	config TDMB_VENDOR_RAONTECH
		bool "Raontech"
	config TDMB_VENDOR_TELECHIPS
		bool "Telechips"
	comment "*"
	config TDMB_SIMUL
		bool "Simultaion"
endchoice

choice
	depends on TDMB && TDMB_VENDOR_INC
	prompt "chip"
	default TDMB_T39F0
	config TDMB_T39F0
		bool "T39F0"
	config TDMB_T3900
		bool "T3900"
	config TDMB_T3700
		bool "T3700"
	config TDMB_T3300
		bool "T3300"
endchoice

choice
	depends on TDMB && TDMB_VENDOR_FCI
	prompt "chip"
	default TDMB_FC8053
	config TDMB_FC8053
		bool "FC8053"
	config TDMB_FC8050
		bool "FC8050"
endchoice

choice
	depends on TDMB && TDMB_VENDOR_RAONTECH
	prompt "chip"
	default TDMB_MTV318
	config TDMB_MTV318
		bool "MTV318"
endchoice

choice
	depends on TDMB && TDMB_VENDOR_TELECHIPS
	prompt "chip"
	default TDMB_TCC3170
	config TDMB_TCC3170
		bool "TCC3170"
endchoice

choice
	depends on TDMB && !TDMB_SIMUL
	prompt "interface"
	default TDMB_SPI
	config TDMB_SPI
		bool "SPI"
	config TDMB_EBI
		bool "EBI"
	config TDMB_TSIF
		bool "TSIF"
endchoice
```

## drivers/media/video/exynos/fimc-is/Kconfig
```kconfig
config VIDEO_EXYNOS_FIMC_IS
	bool "Exynos FIMC-IS (Image Subsystem) driver"
	depends on VIDEO_EXYNOS && ARCH_EXYNOS4
	default n
	help
	  This is a v4l2 subdev driver for samsung FIMC-IS device.
```

## drivers/media/video/samsung/Kconfig
```kconfig
config VIDEO_SAMSUNG
	bool "Samsung Multimedia Devices"
	depends on VIDEO_CAPTURE_DRIVERS && VIDEO_V4L2
	select VIDEO_FIXED_MINOR_RANGES
	default n
	help
	  This is a representative video4linux configuration for Samsung multimedia devices.

config VIDEO_SAMSUNG_V4L2
	bool "V4L2 API for digital camera to be contributed by samsung"
	depends on VIDEO_DEV && VIDEO_SAMSUNG
	default n
	help
	  This feature is for new V4L2 APIs all about digital camera

if CPU_EXYNOS4210 || CPU_EXYNOS4212 || CPU_EXYNOS4412
	source "drivers/media/video/samsung/fimc/Kconfig"
	source "drivers/media/video/samsung/tvout/Kconfig"
	source "drivers/media/video/samsung/mfc5x/Kconfig"
endif

#For MALI
config VIDEO_MALI400MP_UMP
	bool "Enable MALI and UMP integration"
	depends on VIDEO_SAMSUNG
	default y
	---help---
		This enables MALI and UMP integration in the multimedia device driver

choice
depends on VIDEO_MALI400MP_UMP
prompt "MALI MEMORY OPTION"
default MALI_OSMEM_ONLY
config MALI_DED_ONLY
	bool "mali dedicated memory only"
	---help---
		This enables MALI dedicated memory only option
config MALI_DED_MMU
	bool "mali dedicated memory with mmu enable"
	---help---
		This enables MALI dedicated memory with mmu enable option
config MALI_OSMEM_ONLY
	bool "mali OS memory only"
	---help---
		This enables MALI OS memory only option
config MALI_DED_OSMEM
	bool "mali dedicated memory and OS memory"
	---help---
		This enables MALI dedicated memory and OS memory option
endchoice

config MALI_MEM_SIZE
	int "Dedicated Memory Size"
	depends on VIDEO_MALI400MP_UMP && (MALI_DED_ONLY || MALI_DED_MMU || MALI_DED_OSMEM)
	default "128"
	---help---
		This value is dedicated memory size of Mali GPU(unit is MByte).

# For UMP
config UMP_VCM_ALLOC
	bool "Enable ump-vcm(virtual contiguous memory) memory"
	depends on VIDEO_MALI400MP_UMP && VCM
	default y
	---help---
		Use VCM(virtual-contiguous-memory) to allocate physical memory.

choice
depends on VIDEO_MALI400MP_UMP
prompt "UMP MEMEMORY OPTION"
default UMP_OSMEM_ONLY
config UMP_DED_ONLY
	bool "ump dedicated memory only"
	---help---
		This enables UMP dedicated memory only option
config UMP_OSMEM_ONLY
	bool "ump OS memory only"
	---help---
		This enables UMP OS memory only option
config UMP_VCM_ONLY
	bool "ump VCM memory"
	---help---
		This enables UMP VCM memory only option

endchoice
config UMP_MEM_SIZE
	int "UMP Memory Size"
	depends on VIDEO_MALI400MP_UMP
	default "512"
	---help---
		This value is dedicated memory size of UMP (unit is MByte).

choice
	depends on VIDEO_MALI400MP_UMP
	prompt "Select MALI Version"
	default MALI_UMP_R2P4_LSI
config MALI_UMP_R2P4_LSI
	bool "Uses the R2P4 kernel module"
	---help---
		This uses the r2p4 as a UMP and MALI kernel module
config MALI_UMP_R3P1_LSI
	bool "Uses the R3P1 kernel module"
	---help---
		This uses the r3p1 as a UMP and MALI kernel module
endchoice

# For MALI_UMP_DEBUG
config VIDEO_MALI400MP_UMP_DEBUG
	bool "Enables mali and ump debug messages"
	depends on VIDEO_MALI400MP_UMP
	default n
	---help---
		This enables Mali and UMP driver debug messages.

config VIDEO_MALI400MP_STREAMLINE_PROFILING
	bool "Enables mali streamline profiling"
	depends on VIDEO_MALI400MP_UMP
	default n
	---help---
		This enables Mali streamline profiling.

config VIDEO_MALI400MP_DVFS
	bool "Enables DVFS"
	depends on VIDEO_MALI400MP_UMP && PM
	default y
	---help---
		This enables Mali driver DVFS.

config VIDEO_FIMG2D
	bool
	depends on VIDEO_SAMSUNG
	default n

config VIDEO_FIMG2D_DEBUG
	bool
	depends on VIDEO_FIMG2D
	default n

if ARCH_EXYNOS5
source "drivers/media/video/samsung/fimg2d3x/Kconfig"
source "drivers/media/video/samsung/fimg2d4x/Kconfig"
endif

if ARCH_EXYNOS4
source "drivers/media/video/samsung/fimg2d3x-exynos4/Kconfig"
source "drivers/media/video/samsung/fimg2d4x-exynos4/Kconfig"
endif


if CPU_EXYNOS4210
	source "drivers/media/video/samsung/jpeg/Kconfig"
endif

if CPU_EXYNOS4212 || CPU_EXYNOS4412 || CPU_EXYNOS5250
	source "drivers/media/video/samsung/jpeg_v2x/Kconfig"
endif

if VIDEO_SAMSUNG
comment "Reserved memory configurations"
config VIDEO_SAMSUNG_USE_DMA_MEM
	bool "Use common contigouse dma memory for Multimedia devices"
	depends on SLP

config VIDEO_SAMSUNG_MEMSIZE_DMA
	int "Memory size in kbytes for DMA"
	depends on VIDEO_SAMSUNG_USE_DMA_MEM
	default "5120"

config VIDEO_SAMSUNG_MEMSIZE_FIMC0
	int "Memory size in kbytes for FIMC0"
	depends on VIDEO_FIMC || VIDEO_SAMSUNG_S5P_FIMC
	default "5120"

config VIDEO_SAMSUNG_MEMSIZE_FIMC1
	int "Memory size in kbytes for FIMC1"
	depends on VIDEO_FIMC || VIDEO_SAMSUNG_S5P_FIMC
	default "5120"

config VIDEO_SAMSUNG_MEMSIZE_FIMC2
	int "Memory size in kbytes for FIMC2"
	depends on VIDEO_FIMC || VIDEO_SAMSUNG_S5P_FIMC
	default "5120"

config VIDEO_SAMSUNG_MEMSIZE_FIMC3
	int "Memory size in kbytes for FIMC3"
	depends on VIDEO_FIMC || VIDEO_SAMSUNG_S5P_FIMC
	default "0"

config VIDEO_SAMSUNG_MEMSIZE_MFC
	int "Memory size in kbytes for MFC"
	depends on VIDEO_MFC5X && (VIDEO_MFC_MEM_PORT_COUNT = 1) && (!EXYNOS_CONTENT_PATH_PROTECTION)
	default "65536"

config VIDEO_SAMSUNG_MEMSIZE_MFC0
	int "Memory size in kbytes for MFC port0"
	depends on VIDEO_MFC5X && (VIDEO_MFC_MEM_PORT_COUNT = 2) && (!EXYNOS_CONTENT_PATH_PROTECTION)
	default "41984"

config VIDEO_SAMSUNG_MEMSIZE_MFC1
	int "Memory size in kbytes for MFC port1"
	depends on VIDEO_MFC5X && (VIDEO_MFC_MEM_PORT_COUNT = 2) && (!EXYNOS_CONTENT_PATH_PROTECTION)
	default "41984"

config VIDEO_SAMSUNG_MEMSIZE_MFC_SECURE
	int "Memory size in kbytes for MFC Secure"
	depends on VIDEO_MFC5X && EXYNOS_CONTENT_PATH_PROTECTION
	default "41984"

config VIDEO_SAMSUNG_MEMSIZE_MFC_NORMAL
	int "Memory size in kbytes for MFC Normal"
	depends on VIDEO_MFC5X && EXYNOS_CONTENT_PATH_PROTECTION
	default "41984"

config VIDEO_SAMSUNG_MEMSIZE_JPEG
	int "Memory size in kbytes for JPEG"
	depends on VIDEO_JPEG || (VIDEO_JPEG_V2X && (CPU_EXYNOS4212 || CPU_EXYNOS4412))
	default "40960"

config VIDEO_SAMSUNG_MEMSIZE_TVOUT
	int "Memory size in kbytes for TVOUT"
	depends on VIDEO_TVOUT
	default "16384"
endif
```
