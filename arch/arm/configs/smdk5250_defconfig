## drivers/media/video/samsung/mali_r2p3/Kconfig
```kconfig
#
## S3C Multimedia Mali configuration
##
#
# For Mali
config VIDEO_MALI400MP_R2P3
	bool "Enable MALI integration"
	depends on VIDEO_SAMSUNG
	default n
	---help---
                This enables MALI integration in the multimedia device driver

choice
	prompt "MALI MEMORY OPTION"
	depends on VIDEO_MALI400MP_R2P3
	default MALI_OSMEM_ONLY_R2P3

	config MALI_DED_ONLY_R2P3
		bool "mali dedicated memory only"
		---help---
		  This enables MALI dedicated memory only option

	config MALI_DED_MMU_R2P3
		bool "mali dedicated memory with mmu enable"
		---help---
		  This enables MALI dedicated memory with mmu enable option

	config MALI_OSMEM_ONLY_R2P3
		bool "mali OS memory only"
		---help---
		  This enables MALI OS memory only option

	config MALI_DED_OSMEM_R2P3
		bool "mali dedicated memory and OS memory"
		---help---
		  This enables MALI dedicated memory and OS memory option
endchoice

config MALI_MEM_SIZE
	int "Dedicated Memory Size"
	depends on VIDEO_MALI400MP_R2P3 && (MALI_DED_ONLY_R2P3 || MALI_DED_MMU_R2P3 || MALI_DED_OSMEM_R2P3)
	default "128"
	---help---
	  This value is dedicated memory size of Mali GPU(unit is MByte).

# For DEBUG
config VIDEO_MALI400MP_DEBUG
	bool "Enables debug messages"
	depends on VIDEO_MALI400MP_R2P3
	default n
	help
	  This enables Mali driver debug messages.

config MALI_CLK_DMESG_DEBUG
	bool "Enables dmesg debug messages for MALI GPU clock change "
	depends on VIDEO_MALI400MP_R2P3
	default n
	help
	  This enables Mali driver CLK debug messages with dmesg.

config VIDEO_MALI400MP_DVFS
	bool "Enables DVFS"
	depends on VIDEO_MALI400MP_R2P3 && PM
	default y
	help
	  This enables Mali driver DVFS.

config VIDEO_MALI400MP_PROFILING
	bool "Enables Profiling"
	depends on VIDEO_MALI400MP_R2P3
	help
	  This enables Mali driver profiling.
```

## drivers/media/video/samsung/mali_r3p0/Kconfig
```kconfig
#
## S3C Multimedia Mali configuration
##
#
# For Mali
config VIDEO_MALI400MP_R3P0
	bool "Enable MALI integration"
	depends on VIDEO_SAMSUNG
	default n
	---help---
                This enables MALI integration in the multimedia device driver

choice
	prompt "MALI MEMORY OPTION"
	depends on VIDEO_MALI400MP_R3P0
	default MALI_OSMEM_ONLY_R3P0

	config MALI_DED_ONLY_R3P0
		bool "mali dedicated memory only"
		---help---
		  This enables MALI dedicated memory only option

	config MALI_DED_MMU_R3P0
		bool "mali dedicated memory with mmu enable"
		---help---
		  This enables MALI dedicated memory with mmu enable option

	config MALI_OSMEM_ONLY_R3P0
		bool "mali OS memory only"
		---help---
		  This enables MALI OS memory only option

	config MALI_DED_OSMEM_R3P0
		bool "mali dedicated memory and OS memory"
		---help---
		  This enables MALI dedicated memory and OS memory option
endchoice

config MALI_MEM_SIZE
	int "Dedicated Memory Size"
	depends on VIDEO_MALI400MP_R3P0 && (MALI_DED_ONLY_R3P0 || MALI_DED_MMU_R3P0 || MALI_DED_OSMEM_R3P0)
	default "128"
	---help---
	  This value is dedicated memory size of Mali GPU(unit is MByte).

config VIDEO_MALI400MP_GLOBAL_LOCK
	bool "Enable DDK Global Lock"
	depends on VIDEO_MALI400MP_R3P0
	default n
	---help---
	  This support Mali DDK global lock feature for SLP.

# For DEBUG
config VIDEO_MALI400MP_DEBUG
	bool "Enables debug messages"
	depends on VIDEO_MALI400MP_R3P0
	default n
	help
	  This enables Mali driver debug messages.

config VIDEO_MALI400MP_DVFS
	bool "Enables DVFS"
	depends on VIDEO_MALI400MP_R3P0 && PM
	default y
	help
	  This enables Mali driver DVFS.
```

## drivers/media/video/samsung/mali_r3p0_lsi/Kconfig
```kconfig
#
## S3C Multimedia Mali configuration
##
#
# For Mali
config MALI_R3P0_LSI
	bool "Enable MALI_R3P0_LSI integration"
	depends on VIDEO_SAMSUNG
	default y
	---help---
                This enables MALI integration in the multimedia device driver
```

## drivers/media/video/samsung/tvout/mhl/Kconfig
```kconfig
#
# mhl drivers configuration
#

menu "Mhl(sii9244) device support"


config SAMSUNG_MHL
        bool "Enable Sii9244 MHL Chip Driver"
        default n
        ---help---
          support Sii9244 MHL Chip Driver


config SAMSUNG_USE_11PIN_CONNECTOR
	bool "11pin micro-usb connector support"
	default n
	---help---
	  use 11pin micro usb connector instead of 5pin

endmenu
```

## drivers/motor/Kconfig
```kconfig
#
#
#
menuconfig VIBETONZ
	tristate "Vibetonz"
	default y
	help
	  Say Y to enable Vibetonz support.

config MOTOR_DRV_MAX77693
	tristate "Maxim MAX77693 motor"
	default y
	depends on MFD_MAX77693
	help
	  If you say yes here you will get support for the
	  motor of Maxim MAX77693 PMIC.

config MOTOR_DRV_MAX8997
	tristate "Maxim MAX8997 motor"
	default y
	depends on MFD_MAX8997
	help
	  If you say yes here you will get support for the
	  motor of Maxim MAX8997 PMIC.
```

## drivers/net/wireless/bcmdhd/Kconfig
```kconfig
config BCM4334
	tristate "---Broadcom WiFi Driver for 4334"
	depends on WLAN
	---help---
		Select this option to build Broadcom wlan driver

config BCM4330
	tristate "---Broadcom WiFi Driver for 4330"
	depends on WLAN
	---help---
		Select this option to build Broadcom wlan driver

config BCM43241
	tristate "---Broadcom WiFi Driver for 43241"
	depends on WLAN
	---help---
		Select this option to build Broadcom wlan driver

config BROADCOM_WIFI_RESERVED_MEM
	bool "BROADCOM Reserved memory for wifi device"
    depends on (BCM4330 || BCM4334 || BCM43241)
	---help---
		This is a configuration for broadcom WLAN driver.
```

## drivers/net/wireless/mwlan_aarp/Kconfig
```kconfig
config LGUIWLAN
	tristate "LGU IWLAN support"
	default n
	---help---
	  This module adds support for LGU IWLAN
```

## drivers/samsung/Kconfig
```kconfig
#
#
#
menuconfig J4FS
	tristate "Samsung J4FS support"
	default m
	help
	  Say Y to enable Samsung J4FS support.

menuconfig FM_RADIO
	tristate "FM Radio Driver"
	default n
	help
	  Say Y to enable FM Radio Driver

menuconfig FM_SI4709
	tristate "Si4709 FM radio"
	depends on FM_RADIO
	default n
	help
	  Say Y to enable Si4709 FM radio support.

 menuconfig FM_SI4705
	tristate "Si4705 FM radio"
	depends on FM_RADIO
	default n
	help
	  Say Y to enable Si4705 FM radio support.
```
